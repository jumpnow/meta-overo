## conf/layer.conf
```bitbake
# We have a conf and classes directory, append to BBPATH
BBPATH .= ":${LAYERDIR}"

# We have a recipes directory, add to BBFILES
BBFILES += "${LAYERDIR}/recipes*/*/*.bb ${LAYERDIR}/recipes*/*/*.bbappend ${LAYERDIR}/images/*.bb"

BBFILE_COLLECTIONS += "meta-overo"
BBFILE_PATTERN_meta-overo := "^${LAYERDIR}/"
BBFILE_PRIORITY_meta-overo = "16"

LAYERSERIES_COMPAT_meta-overo = "honister"
```

## conf/machine/overo.conf
```bitbake
#@TYPE: Machine
#@NAME: Overo machine
#@DESCRIPTION: Machine configuration for the Gumstix Overo 

SOC_FAMILY = "omap3"
TARGET_ARCH = "arm"

DEFAULTTUNE = "cortexa8hf-neon"

require conf/machine/include/soc-family.inc
require conf/machine/include/arm/armv7a/tune-cortexa8.inc

PREFERRED_PROVIDER_virtual/kernel = "linux-stable"

PREFERRED_PROVIDER_virtual/bootloader = "u-boot"
PREFERRED_PROVIDER_u-boot = "u-boot"

UBOOT_ENTRYPOINT = "0x80008000"
UBOOT_LOADADDRESS = "0x80008000"
UBOOT_MACHINE = "omap3_overo_config"

EXTRA_IMAGEDEPENDS += "u-boot u-boot-scr"

SERIAL_CONSOLES = "115200;ttyO2"

IMAGE_FSTYPES = "tar.xz"

MACHINE_ESSENTIAL_EXTRA_RDEPENDS = "kernel-image kernel-devicetree"

MACHINE_FEATURES = "ext2 serial usbhost vfat"
```
