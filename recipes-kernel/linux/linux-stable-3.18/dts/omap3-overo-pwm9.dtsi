/*
 * Copyright (C) 2016 Jumpnow Technologies, LLC 
 *
 * This program is free software; you can redistribute it and/or modify
 * it under the terms of the GNU General Public License version 2 as
 * published by the Free Software Foundation.
 */

&omap3_pmx_core {
	pwm9_pin: pinmux_pwm9_pin {
		pinctrl-single,pins = <
			OMAP3_CORE1_IOPAD(0x2174, PIN_OUTPUT | MUX_MODE2)       /* uart2_cts.gpt9_pwm_evt */
		>;
	};
};

/ {
	pwm9: dmtimer-pwm@9 {
		compatible = "ti,omap-dmtimer-pwm";
		pinctrl-names = "default";
		pinctrl-0 = <&pwm9_pin>;
		ti,timers = <&timer9>;
		#pwm-cells = <3>;
	};
};
