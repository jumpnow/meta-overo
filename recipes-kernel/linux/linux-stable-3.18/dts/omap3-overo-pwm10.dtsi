/*
 * Copyright (C) 2016 Jumpnow Technologies, LLC 
 *
 * This program is free software; you can redistribute it and/or modify
 * it under the terms of the GNU General Public License version 2 as
 * published by the Free Software Foundation.
 */

&omap3_pmx_core {
	pwm10_pin: pinmux_pwm10_pin {
		pinctrl-single,pins = <
			OMAP3_CORE1_IOPAD(0x2176, PIN_OUTPUT | MUX_MODE2)       /* uart2_rts.gpt10_pwm_evt */
		>;
	};
};

/ {
	pwm10: dmtimer-pwm@10 {
		compatible = "ti,omap-dmtimer-pwm";
		pinctrl-names = "default";
		pinctrl-0 = <&pwm10_pin>;
		ti,timers = <&timer10>;
		#pwm-cells = <3>;
	};
};
