/*
 * Copyright (C) 2016 Jumpnow Technologies, LLC 
 *
 * This program is free software; you can redistribute it and/or modify
 * it under the terms of the GNU General Public License version 2 as
 * published by the Free Software Foundation.
 */

&omap3_pmx_core {
	pwm8_pin: pinmux_pwm8_pin {
		pinctrl-single,pins = <
			OMAP3_CORE1_IOPAD(0x217a, PIN_OUTPUT | MUX_MODE2)       /* uart2_rx.gpt8_pwm_evt */
		>;
	};
};

/ {
	pwm8: dmtimer-pwm@8 {
		compatible = "ti,omap-dmtimer-pwm";
		pinctrl-names = "default";
		pinctrl-0 = <&pwm8_pin>;
		ti,timers = <&timer8>;
		#pwm-cells = <3>;
	};
};
