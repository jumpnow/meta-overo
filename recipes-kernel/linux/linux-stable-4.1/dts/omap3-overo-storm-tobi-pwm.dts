/*
 * Copyright (C) 2016 Jumpnow Technologies, LLC 
 *
 * This program is free software; you can redistribute it and/or modify
 * it under the terms of the GNU General Public License version 2 as
 * published by the Free Software Foundation.
 */

/dts-v1/;

#include "omap3-overo-storm.dtsi"
#include "omap3-overo-tobi-common.dtsi"
#include "omap3-overo-pwm8.dtsi"
#include "omap3-overo-pwm9.dtsi"
#include "omap3-overo-pwm10.dtsi"
#include "omap3-overo-pwm11.dtsi"

/ {
	model = "OMAP36xx/AM37xx/DM37xx Gumstix Overo on Tobi";
	compatible = "gumstix,omap3-overo-tobi", "gumstix,omap3-overo", "ti,omap36xx", "ti,omap3";
};
